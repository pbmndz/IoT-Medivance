#include <WiFi.h>
#include <Wire.h>
#include <Arduino.h>
#include <Firebase_ESP_Client.h>
#include <Adafruit_GFX.h>
#include <Adafruit_SSD1306.h>
#include <U8g2lib.h>
#include <WebServer.h>
#include <Preferences.h>
#include "FastLED.h"
#include "ani.h"
#include "esp_sntp.h"
#include "addons/TokenHelper.h"
#include "addons/RTDBHelper.h"
#include <ArduinoJson.h>
#include <Arduino.h> 
#include "Countimer.h"
Countimer tdown;
// Insert Firebase project API Key
#define API_KEY "AIzaSyBmJ0ibz-8MF6HP7H3wJeKhxYx1Rwca17Y"
// Insert RTDB URLefine the RTDB URL 
#define DATABASE_URL "https://mydoserx-app-default-rtdb.firebaseio.com/" 

//Define Firebase Data object
FirebaseData fbdo;
FirebaseAuth auth;
FirebaseConfig config;
// Preferences
Preferences preferences;

//monitor 
U8G2_SSD1306_128X64_NONAME_F_HW_I2C u8g2(U8G2_R0);
ani myAni;
int counter = 0; 

// Define the control pins for the CD74HC4067
#define S0 15
#define S1 2
#define S2 4
#define S3 0
#define SIG 36
// button 
// menu
#define BUTTON_UP_PIN 35 // pin for UP button 
#define BUTTON_SELECT_PIN 32 // pin for SELECT button
#define BUTTON_DOWN_PIN 33 // pin for DOWN button

int buzzer = 12; // buzzer pin

//reset
const int reset = 39; 

// stop
const int BUTTON_STOP_PIN = 34; 

//offline 
int seconds = 0;
int minutes = 0;
int hours = 0;
int last_seconds = 0;
int last_minutes = 0;
int last_hours = 0;
int set = 0;
bool condition_set = 0;
bool condition_reset = 0;

unsigned long lastmillis; 


// Wifi //
// local wifi
const char* ssid = "DoseRx";
const char* password = "DoseRx123!";
// Flash Memory preference saved SSID and Password
String SSID;
String PASS;
WebServer server(80); // Create a WebServer object on port 80

// flag
bool reconnectAttempted = false;  //for checkAndReconnectWiFi
bool wasConnected = false; //for loop
bool pressed = false;
unsigned long sendDataPrevMillis = 0;
bool signupOK = false;
bool userConnectedToESP = false; // qr
bool messageDisplayed = false;
bool clearDisplayQR = true;

// menu

int button_up_clicked = 0; // only perform action when button is clicked, and wait until another press
int button_select_clicked = 0; // same as above
int button_down_clicked = 0; // same as above
int item_selected = 0; // which item in the menu is selected
int item_sel_previous; // previous item - used in the menu screen to draw the item before the selected one
int item_sel_next; // next item - used in the menu screen to draw next item after the selected one
int current_screen = 0;   // 0 = menu, 1 = screenshot, 2 = qr
int demo_mode = 0; // when demo mode is set to 1, it automatically goes over all the screens, 0 = control menu with buttons
int demo_mode_state = 0; // demo mode state = which screen and menu item to display
int demo_mode_delay = 0; // demo mode delay = used to slow down the screen switching

// Define variables to track button press timing
unsigned long button_press_time = 0;
const unsigned long long_press_duration = 3000; // Adjust the duration as needed (in milliseconds)

// LED Strips
#define NUM_LEDS 5 // How many leds in your strip?
#define DATA_PIN 16
CRGB leds[NUM_LEDS]; // Define the array of leds
//time 
const char* ntpServer = "asia.pool.ntp.org";
const long  gmtOffset_sec = 8 * 3600; // Philippines is GMT +8
const int   daylightOffset_sec = 0; // No daylight saving time in Philippines

void setTime(){
  struct tm timeinfo;
  if(!getLocalTime(&timeinfo)){
    Serial.println("Failed to obtain time");
    return;
  }

  // Calculate the number of seconds until 5 AM
  struct tm targetTime = timeinfo; // Copy current time structure
  targetTime.tm_hour = 5; // Set target hour to 5 AM
  targetTime.tm_min = 0; // Set target minutes to 0
  targetTime.tm_sec = 0; // Set target seconds to 0

  // Adjust for next day if current hour is past 5 AM
  if(timeinfo.tm_hour >= 5){
    targetTime.tm_mday += 1;
  }

  // Convert both current time and target time to time_t format
  time_t currentTime_t = mktime(&timeinfo);
  time_t targetTime_t = mktime(&targetTime);

  // Calculate difference in seconds
  double secondsUntilTarget = difftime(targetTime_t, currentTime_t);

  // Calculate hours, minutes, and seconds from difference
  int hours = int(secondsUntilTarget) / 3600;
  int minutes = (int(secondsUntilTarget) % 3600) / 60;
  int seconds = int(secondsUntilTarget) % 60;

  // Display current date and time as before
  String AM_PM = (timeinfo.tm_hour >= 12) ? "PM" : "AM";
  
   // Convert hour from the military (24-hour) format to the standard (12-hour) format for display purposes
   int displayHour = timeinfo.tm_hour % 12;
   if(displayHour == 0) displayHour = 12; // Convert '0' hour to '12' for readability

   char dateStringBuff[50]; 
   strftime(dateStringBuff, sizeof(dateStringBuff), "%B, %d, %Y", &timeinfo);
   char timeStringBuff[50]; 
   strftime(timeStringBuff, sizeof(timeStringBuff), "%I:%M:%S", &timeinfo);
   
   u8g2.setFont(u8g2_font_ncenB08_tr);
   u8g2.drawStr(5,25,dateStringBuff);
   u8g2.setCursor(5,35);
   u8g2.print(timeStringBuff);
   u8g2.print(" ");
   u8g2.print(AM_PM.c_str());

   // Display countdown timer
   char countdownStringBuff[50];
   sprintf(countdownStringBuff, "Countdown: %02d:%02d:%02d", hours, minutes, seconds);
   u8g2.drawStr(5,45,countdownStringBuff); 
}

// scan wifi ssid
void handleScanWiFi() {
  WiFi.disconnect();
  delay(100);  // Smal
  int n = WiFi.scanNetworks();
  Serial.print("scaning");
  DynamicJsonDocument doc(1024);
  JsonArray array = doc.to<JsonArray>();
  for (int i = 0; i < n; ++i) {
    Serial.println(WiFi.SSID(i));
    array.add(WiFi.SSID(i));
  }
  String response;
  serializeJson(doc, response);
  server.send(200, "application/json", response);
}

// website
void handleRoot() {
    const char* html = "<!DOCTYPE html>\
    <html>\
    <head>\
        <meta name=\"viewport\" content=\"width=device-width, initial-scale=1.0, maximum-scale=1.0, user-scalable=no\">\
        <style>\
            body {\
                font-family: Arial, sans-serif;\
                margin: 0;\
                padding: 0;\
            }\
            .center-form {\
                display: flex;\
                flex-direction: column;\
                justify-content: center;\
                align-items: center;\
                height: 100vh;\
            }\
            .center-form form {\
                width: 80%;\
                max-width: 300px;\
                font-size: 0.9em;\
                text-align: center;\
                margin-top: 20px;\
            }\
            h1 {\
                font-size: 1.5em;\
            }\
            p {\
                font-size: 0.8em;\
                text-align: center;\
            }\
            input[type=\"text\"],\
            input[type=\"password\"] {\
                width: calc(100% - 20px);\
                height: 25px;\
                font-size: 0.9em;\
                margin-bottom: 10px;\
                padding: 5px;\
            }\
            select {\
                width: calc(100% - 20px);\
                height: 30px;\
                font-size: 0.9em;\
                margin-bottom: 10px;\
                padding: 5px;\
            }\
            input[type=\"submit\"] {\
                width: 100%;\
                height: 30px;\
                font-size: 0.9em;\
                background-color: #4CAF50;\
                color: white;\
                border: none;\
                cursor: pointer;\
            }\
            button.refresh {\
                width: 30%;\
                height: 40px;\
                font-size: 1em;\
                color: black;\
                border-radius: 8px;\
                border: none;\
                cursor: pointer;\
                margin-top: 3px;\
                margin-bottom: 3px;\
            }\
            button.submit:hover {\
                background-color: #45a049; /* Darker green on hover */\
            }\
            #loading {\
                display: none;\
                position: fixed;\
                width: 100%;\
                height: 100%;\
                top: 0;\
                left: 0;\
                right: 0;\
                bottom: 0;\
                background-color: rgba(255, 255, 255, 0.8);\
                z-index: 9999;\
                text-align: center;\
                padding-top: 200px;\
                font-size: 1.5em;\
            }\
            @media only screen and (max-width: 600px) {\
                .center-form form {\
                    font-size: 0.8em;\
                }\
                h1 {\
                    font-size: 1.2em;\
                }\
                p {\
                    font-size: 0.7em;\
                }\
                input[type=\"text\"],\
                input[type=\"password\"] {\
                    height: 30px;\
                    font-size: 0.8em;\
                }\
                select {\
                    height: 35px;\
                    font-size: 0.8em;\
                }\
                button.refresh {\
                    height: 30px;\
                    font-size: 0.8em;\
                }\
                button.submit {\
                    width: calc(100% - 20px);\
                    height: 40px; /* Increased height for the submit button */\
                    font-size: 1em; /* Larger font size for better readability */\
                    background-color: #4CAF50;\
                    color: white;\
                    border: none;\
                    cursor: pointer;\
                    margin-top: 10px;\
                }\
            }\
        </style>\
        <script>\
            function refreshNetworks() {\
                document.getElementById('loading').style.display = 'block';\
                var xhr = new XMLHttpRequest();\
                xhr.open('GET', '/scanwifi', true);\
                xhr.onload = function () {\
                    if (xhr.status === 200) {\
                        var networks = JSON.parse(xhr.responseText);\
                        var selectElement = document.getElementById('ssid');\
                        selectElement.innerHTML = '';\
                        networks.forEach(function(network) {\
                            var option = document.createElement('option');\
                            option.text = network;\
                            selectElement.add(option);\
                        });\
                        document.getElementById('loading').style.display = 'none';\
                    } else {\
                        alert('Failed to scan networks.');\
                        document.getElementById('loading').style.display = 'none';\
                    }\
                };\
                xhr.send();\
            }\
            document.addEventListener('DOMContentLoaded', refreshNetworks); // Automatically refresh networks on page load\
        </script>\
    </head>\
    <body>\
        <div id=\"loading\">Scanning for networks...</div>\
        <div class=\"center-form\" id=\"content\">\
            <h1>Please Enter your Wifi Credentials</h1>\
            <p>Please select your Wifi SSID and enter the Password:</p>\
            <form action=\"/submit\" method=\"POST\">\
                Wifi SSID:<br>\
                <select name=\"Wifi SSID\" id=\"ssid\"></select><br>\
                <button type=\"button\" class=\"refresh\" onclick=\"refreshNetworks()\">Refresh</button><br>\
                Password:<br>\
                <input type=\"password\" name=\"Password\"><br><br>\
                <input type=\"submit\" class=\"submit\" value=\"Submit\">\
            </form>\
        </div>\
    </body>\
    </html>";

    server.send(200, "text/html", html);
}

void handleError() {
  const char* html = "<!DOCTYPE html>\
  <html>\
  <head>\
    <meta name=\"viewport\" content=\"width=device-width, initial-scale=1.0, maximum-scale=1.0, user-scalable=no\">\
    <style>\
      body {\
        font-family: Arial, sans-serif;\
        display: flex;\
        justify-content: center;\
        align-items: center;\
        height: 100vh;\
        margin: 0;\
      }\
      .center {\
        text-align: center;\
      }\
    </style>\
    <script>\
      setTimeout(function() {\
        window.location.href = '/';\
      }, 1000);\
    </script>\
  </head>\
  <body>\
    <div class=\"center\">\
      <h1>Error</h1>\
      <p>The password is incorrect. Redirecting to the main page...</p>\
    </div>\
  </body>\
  </html>";
  server.send(200, "text/html", html);
}

void handleWiFiConnected() {
  const char* success = "<!DOCTYPE html>\
  <html>\
  <head>\
    <meta name=\"viewport\" content=\"width=device-width, initial-scale=1.0, maximum-scale=1.0, user-scalable=no\">\
    <style>\
      body {\
        font-family: Arial, sans-serif;\
        margin: 0;\
        padding: 0;\
      }\
      .center-form {\
        display: flex;\
        flex-direction: column;\
        justify-content: center;\
        align-items: center;\
        height: 100vh;\
      }\
      .center-form form {\
        width: 80%;\
        max-width: 300px;\
        font-size: 0.9em;\
        text-align: center;\
      }\
      h1 {\
        font-size: 2em;\
      }\
      p {\
        font-size: 1em;\
        text-align: center;\
      }\
      @media only screen and (max-width: 600px) {\
        .center-form form {\
          font-size: 0.8em;\
        }\
        h1 {\
          font-size: 1.5em;\
        }\
        p {\
          font-size: 0.9 em;\
        }\
    </style>\
    <script>\
      function closeWindow() {\
        window.open('', '_self', '');\
        window.close();\
      }\
    </script>\
  </head>\
  <body>\
    <div class=\"center-form\">\
      <h1>DoseRx is Connected</h1>\
      <p>you may now close the browser and reconnect to your wifi</p>\
      <button onclick=\"closeWindow()\">Close</button>\
    </div>\
  </body>\
  </html>";
  server.send(200, "text/html", success);
}

// end website

// start webserver
void fireBase() {
    config.api_key = API_KEY;
    config.database_url = DATABASE_URL;

    // Sign up 
    if (Firebase.signUp(&config, &auth, "", "")){
      Serial.println("ok");
      signupOK = true;
    }
    else{
      Serial.printf("%s\n", config.signer.signupError.message.c_str());
    }
    config.token_status_callback = tokenStatusCallback; 
    Firebase.begin(&config, &auth);
    Firebase.reconnectWiFi(true);
}

void handleSubmit() {
  if(server.method() == HTTP_POST) {
    String SSID = server.arg("Wifi SSID");
    String PASS = server.arg("Password");
    Serial.println("SSID: ");
    Serial.println(SSID);
    Serial.println("PASS: ");
    Serial.println(PASS);

    preferences.begin("credentials", false);
    preferences.putString("ssid", SSID);
    preferences.putString("pass", PASS);
    preferences.end();

    WiFi.begin(SSID.c_str(), PASS.c_str());
    unsigned long startMillis = millis();  
    while (WiFi.status() != WL_CONNECTED) {
      if (millis() - startMillis >= 10000) {  //  If 10 seconds have passed
        Serial.println("Failed to connect to WiFi after 15 seconds.");
        server.sendHeader("Location", "/error", true);
        server.send(302, "text/plain", "");
        break;
      }
      Serial.print(".");
      delay(300);
    } 
    if (WiFi.status() == WL_CONNECTED) {
      clearDisplayQR = false;
      Serial.println();
      Serial.println("handleSubmit");
      Serial.print("Connected with IP: ");
      Serial.println(WiFi.localIP());
      handleWiFiConnected();
      fireBase();
    } else {
      Serial.println("Incorrect password or SSID. Re-scanning networks.");
      handleScanWiFi();  // Call handleScanWiFi to rescan networks
    }
  }
}

void webServerStart(){
  WiFi.mode(WIFI_STA);
  WiFi.disconnect();
  WiFi.softAP(ssid, password);
  Serial.println();
  Serial.print("Access Point \"");
  Serial.print(ssid);
  Serial.println("\" started");
  IPAddress IP = WiFi.softAPIP();
  Serial.print("IP Address: ");
  Serial.println(IP);
// Set up server routes

    // Set up server routes
    server.on("/", handleRoot);
    server.on("/submit", HTTP_POST, handleSubmit);
    server.on("/error", handleError); // Handle errors
    server.on("/scanwifi", HTTP_GET, handleScanWiFi); // Use handleScanWiFi for /scanwifi

  server.onNotFound([]() {
    server.send(404, "text/plain", "404: Not found");
  });

// Start server
  server.begin();
  Serial.println("HTTP server started");  
// clear wifi cred
  preferences.begin("credentials", false);
  preferences.clear();
  preferences.end();
  WiFi.disconnect(); 
}

void SavedCredentials(){
    preferences.begin("credentials", false);
    String savedSSID = preferences.getString("ssid");
    String savedPASS = preferences.getString("pass");
    preferences.end();

    Serial.println();
    Serial.println("trying connecting to saved credentials .........");
    Serial.println(savedSSID);
    Serial.println(savedPASS);

    u8g2.clearBuffer();

    WiFi.begin(savedSSID.c_str(), savedPASS.c_str());
    unsigned long startMillis = millis();  
    while (WiFi.status() != WL_CONNECTED) {
      if (savedSSID == "" || savedPASS == "" or millis() - startMillis >= 15000){
        webServerStart();
        break;
      }
      Serial.print(".");
      delay(300);

    } 
    if (WiFi.status() == WL_CONNECTED) {
      clearDisplayQR = false;
      Serial.println();
      Serial.print("Connected with IP: ");
      Serial.println(WiFi.localIP());
      handleWiFiConnected();
      fireBase();
      configTime(gmtOffset_sec, daylightOffset_sec, ntpServer);
      setTime();
  } 
}

void checkAndReconnectWiFi() {
  if (WiFi.status() != WL_CONNECTED && !reconnectAttempted) {
    Serial.println("WiFi is disconnected. Trying to reconnect...");
    SavedCredentials(); // Try to reconnect using saved credentials
    reconnectAttempted = true;
    userConnectedToESP = false;
    messageDisplayed = false;

    u8g2.clearBuffer();

    // Check if reconnection was successful
    if (WiFi.status() == WL_CONNECTED) {
      Serial.println("Reconnected successfully!");
      clearDisplayQR = false;
    } else {
      Serial.println("Reconnection failed. Please enter new SSID/PASS.");
    }
    // Reset the flag after the reconnection process
    reconnectAttempted = false;
  }
}

// about 
const char* messages[] = {
  "DoseRx Medivance",
  "improves medication",
  "management with ",
  "advanced features",
  " ",
  "           next --->"
};
const char* info[] = {
  "Device name: DoseRx",
  " ",
  "SSID: DoseRx",
  "PASSWORD: DoseRx123",
  " ",
  "           next --->"
};
//offline





// display
void animation(){
  while(true) { 
    u8g2.clearBuffer(); 
    u8g2.drawXBMP(0, 0, 128, 64, myAni.getBitmap(counter));
    u8g2.sendBuffer(); 
    counter = (counter + 1) % 42; 
    if (counter == 41) { 
      delay(1000); 
      u8g2.clearBuffer(); 
      break;
    }
  }
}

// sensor value 
void selectMuxChannel(int channel) {
  digitalWrite(S0, bitRead(channel, 0));
  digitalWrite(S1, bitRead(channel, 1));
  digitalWrite(S2, bitRead(channel, 2));
  digitalWrite(S3, bitRead(channel, 3));
}

int channel0() {
    selectMuxChannel(0);
    int analogValue = analogRead(SIG);
    return analogValue;
    // if(analogValue > 350){
    //   return true;
    // } else{
    //   return false;
    // }
}


const unsigned char epd_bitmap_scan_to_connect [] PROGMEM = {
	0xff, 0xff, 0xff, 0xff, 0xff, 0xff, 0xff, 0xff, 0xff, 0xff, 0xff, 0xff, 0xff, 0xff, 0xff, 0xff, 
	0xff, 0xff, 0xff, 0xff, 0xff, 0xff, 0xff, 0xff, 0xff, 0xff, 0xff, 0xff, 0xff, 0xff, 0xff, 0xff, 
	0xff, 0xff, 0xff, 0xff, 0xff, 0xff, 0xff, 0xff, 0xff, 0xff, 0xff, 0xff, 0xff, 0xff, 0xff, 0xff, 
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	0xff, 0xff, 0xff, 0xff, 0xff, 0xff, 0xff, 0xff, 0xff, 0xff, 0xff, 0xff, 0xff, 0xff, 0xff, 0xff
};

// 'SCAN TO GO WEBSITE', 128x64px
const unsigned char epd_bitmap_SCAN_TO_GO_WEBSITE [] PROGMEM = {
	0xff, 0xff, 0xff, 0xff, 0xff, 0xff, 0xff, 0xff, 0xff, 0xff, 0xff, 0xff, 0xff, 0xff, 0xff, 0xff, 
	0xff, 0xff, 0xff, 0xff, 0xff, 0xff, 0xff, 0xff, 0xff, 0xff, 0xff, 0xff, 0xff, 0xff, 0xff, 0xff, 
	0xff, 0xff, 0xff, 0xff, 0xff, 0xff, 0xff, 0xff, 0xff, 0xff, 0xff, 0xff, 0xff, 0xff, 0xff, 0xff, 
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	0xff, 0xff, 0xff, 0xff, 0xff, 0xff, 0xff, 0xff, 0xff, 0xff, 0xff, 0xff, 0xff, 0xff, 0xff, 0xff
};

// 'wifi', 20x16px
const unsigned char epd_bitmap_wifi [] PROGMEM = {
	0x00, 0x00, 0x00, 0x00, 0x00, 0x00, 0x00, 0x00, 0x00, 0x80, 0x1f, 0x00, 0xe0, 0x79, 0x00, 0x30, 
	0xc0, 0x00, 0x80, 0x1f, 0x00, 0xc0, 0x30, 0x00, 0x00, 0x06, 0x00, 0x80, 0x1f, 0x00, 0x00, 0x00, 
	0x00, 0x00, 0x00, 0x00, 0x00, 0x06, 0x00, 0x00, 0x00, 0x00, 0x00, 0x00, 0x00, 0x00, 0x00, 0x00
};

// menu
// 'icon_offline', 16x16px
const unsigned char epd_bitmap_icon_offline [] PROGMEM = {
	0x00, 0x00, 0x00, 0x60, 0x00, 0x30, 0xf0, 0x0f, 0x38, 0x1c, 0x06, 0x7e, 0xc2, 0x47, 0xf0, 0x0e, 
	0x98, 0x19, 0xc8, 0x10, 0xc0, 0x03, 0x60, 0x05, 0x30, 0x06, 0x98, 0x01, 0x8c, 0x01, 0x00, 0x00
};
// 'online', 16x16px
const unsigned char epd_bitmap_online [] PROGMEM = {
	0x00, 0x00, 0x00, 0x00, 0xe0, 0x03, 0xf8, 0x1f, 0xfc, 0x1f, 0x1e, 0x78, 0xe7, 0xe7, 0xf0, 0x0f, 
	0x38, 0x1c, 0x98, 0x19, 0xc0, 0x07, 0x60, 0x0e, 0x00, 0x00, 0x80, 0x01, 0x80, 0x01, 0x00, 0x00
};
// 'icon_setings', 16x16px
const unsigned char epd_bitmap_info [] PROGMEM = {
	0xf0, 0x0f, 0xf8, 0x1f, 0x1c, 0x30, 0x06, 0x60, 0x82, 0x61, 0x83, 0xc1, 0x03, 0x80, 0xc3, 0xc1, 
	0x83, 0xc1, 0x83, 0xc1, 0x83, 0xc1, 0xc3, 0xc3, 0x06, 0x70, 0x0c, 0x38, 0x18, 0x1e, 0xf0, 0x0f
};

// Array of all bitmaps for convenience. (Total bytes used to store images in PROGMEM = 144)
const unsigned char* bitmap_icons[3] = {
	epd_bitmap_icon_offline,
	epd_bitmap_info,
	epd_bitmap_online
};

// 'scrollbar_background', 8x64px
const unsigned char bitmap_scrollbar_background [] PROGMEM = {
  0x00, 0x40, 0x00, 0x40, 0x00, 0x40, 0x00, 0x40, 0x00, 0x40, 0x00, 0x40,
  0x00, 0x40, 0x00, 0x40, 0x00, 0x40, 0x00, 0x40, 0x00, 0x40, 0x00, 0x40,
  0x00, 0x40, 0x00, 0x40, 0x00, 0x40, 0x00, 0x40, 0x00, 0x40, 0x00, 0x40,
  0x00, 0x40, 0x00, 0x40, 0x00, 0x40, 0x00, 0x40, 0x00, 0x40, 0x00, 0x40,
  0x00, 0x40, 0x00, 0x40, 0x00, 0x40, 0x00, 0x40, 0x00, 0x40, 0x00, 0x40,
  0x00, 0x40, 0x00, 0x00, };
// 'item_sel_outline', 128x21px
const unsigned char bitmap_item_sel_outline [] PROGMEM = {
  0xF8, 0xFF, 0xFF, 0xFF, 0xFF, 0xFF, 0xFF, 0xFF, 0xFF, 0xFF, 0xFF, 0xFF,
  0xFF, 0xFF, 0xFF, 0x03, 0x04, 0x00, 0x00, 0x00, 0x00, 0x00, 0x00, 0x00,
  0x00, 0x00, 0x00, 0x00, 0x00, 0x00, 0x00, 0x04, 0x02, 0x00, 0x00, 0x00,
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  0xFF, 0xFF, 0xFF, 0xFF, 0xFF, 0xFF, 0xFF, 0xFF, 0xFF, 0xFF, 0xFF, 0x03,
  };

const int NUM_ITEMS = 3; // number of items in the list and also the number of screenshots and screenshots with QR codes (other screens)
const int MAX_ITEM_LENGTH = 20; // maximum characters for the item name

char menu_items [NUM_ITEMS] [MAX_ITEM_LENGTH] = {  // array with item names
  { "offline" },
  { "About" },
  { "online" },
 };

void timeToDrink(){
    u8g2.clearBuffer();
    u8g2.drawXBMP(0, 0, 20, 16, epd_bitmap_wifi);
    u8g2.drawStr(5,25,"time to drink:");
    u8g2.drawStr(5,35,"time to drink");
    // u8g2.print(" ");
    // u8g2.print("biogesic"); //name of the med
    u8g2.sendBuffer(); 
}

String  firstName(){
if (Firebase.RTDB.getString(&fbdo, "usr/12345/first_name")) {
  if (fbdo.dataType() == "string") {
    String firstName = fbdo.stringData();
    firstName.toUpperCase();
    Serial.print("First Name: ");
    Serial.println(firstName);
    return firstName;
}
  } else {
    Serial.print("FAILED");
    Serial.print("REASON: ");
    Serial.println(fbdo.errorReason());
}
return "";
}

void print_time() {
  seconds = seconds -1;
if (seconds < 0) {
  seconds = 59;
  hours = hours -1;
}
if (minutes < 0) {
  minutes = 59;
  hours = hours - 1;
  } 
}
void setup() {
  Serial.begin(115200);
  u8g2.begin();
  u8g2.setColorIndex(1);  
  u8g2.setBitmapMode(1);
  FastLED.addLeds<NEOPIXEL, DATA_PIN>(leds, NUM_LEDS);
  // CD74HC4067
  pinMode(S0, OUTPUT);
  pinMode(S1, OUTPUT);
  pinMode(S2, OUTPUT);
  pinMode(S3, OUTPUT);
  pinMode(SIG, INPUT);

  pinMode(BUTTON_UP_PIN, INPUT_PULLUP); // up button
  pinMode(BUTTON_SELECT_PIN, INPUT_PULLUP); // select button
  pinMode(BUTTON_DOWN_PIN, INPUT_PULLUP); // down button
  pinMode(reset, INPUT_PULLUP);
  pinMode(BUTTON_STOP_PIN, INPUT_PULLUP);
  pinMode(buzzer, OUTPUT);
  Serial.println("Starting WiFi scan...");
  tdown.setInterval(print_time, 999);
  WiFi.mode(WIFI_STA);
  SavedCredentials();
  animation();


}

void loop() {
  server.handleClient();
  int currentStationCount = WiFi.softAPgetStationNum();
  bool isConnected = WiFi.status() == WL_CONNECTED; 
  // save values for CD74HC4067 
  int value0 = channel0();
  // Serial.println(value0);
    tdown.run();
  //timestarts


  if (current_screen == 0) { // MENU SCREEN
      if ((digitalRead(BUTTON_UP_PIN) == LOW) && (button_up_clicked == 0)) { // up button clicked - jump to previous menu item
        item_selected = item_selected - 1; // select previous item
        button_up_clicked = 1; // set button to clicked to only perform the action once
        if (item_selected < 0) { // if first item was selected, jump to last item
          item_selected = NUM_ITEMS-1;
        }
      }
      else if ((digitalRead(BUTTON_DOWN_PIN) == LOW) && (button_down_clicked == 0)) { // down button clicked - jump to next menu item
        item_selected = item_selected + 1; // select next item
        button_down_clicked = 1; // set button to clicked to only perform the action once
        if (item_selected >= NUM_ITEMS) { // last item was selected, jump to first menu item
          item_selected = 0;
          }
      } 
      if ((digitalRead(BUTTON_UP_PIN) == HIGH) && (button_up_clicked == 1)) { // unclick 
        button_up_clicked = 0;
      }
      if ((digitalRead(BUTTON_DOWN_PIN) == HIGH) && (button_down_clicked == 1)) { // unclick
        button_down_clicked = 0;
      }
  }
      if ((digitalRead(BUTTON_SELECT_PIN) == LOW) && (button_select_clicked == 0)) { // select button clicked, jump between screens
          button_select_clicked = 1;
          if (current_screen == 0) { // menu items screen --> functions
              current_screen = 1;
          } 
          else if (current_screen == 1 && item_selected == 1) {
              current_screen = 2; // settings screen
          }
          else if (current_screen == 1 && item_selected == 0) { // additional condition
              // Check for long press
              if (millis() - button_press_time >= long_press_duration) {
                  current_screen = 0; // Go back to menu items screen for long press
              }
          }
          else {
              current_screen = 0; // last screen --> menu items screen
          }
          // Update button press time
          button_press_time = millis();
      }
      if ((digitalRead(BUTTON_SELECT_PIN) == HIGH) && (button_select_clicked == 1)) { // unclick 
          button_select_clicked = 0;
      }
  // set correct values for the previous and next items
  item_sel_previous = item_selected - 1;
  if (item_sel_previous < 0) {item_sel_previous = NUM_ITEMS - 1;} // previous item would be below first = make it the last
  item_sel_next = item_selected + 1;  
  if (item_sel_next >= NUM_ITEMS) {item_sel_next = 0;} // next item would be after last = make it the first
  u8g2.clearBuffer();  // clear buffer for storing display content in RAM
    if (current_screen == 0) { // MENU SCREEN
      // selected item background
      u8g2.drawXBMP(0, 22, 128, 21, bitmap_item_sel_outline);
      // draw previous item as icon + label
      u8g2.setFont(u8g_font_7x14);
      u8g2.drawStr(25, 15, menu_items[item_sel_previous]); 
      u8g2.drawXBMP( 4, 2, 16, 16, bitmap_icons[item_sel_previous]);          
      // draw selected item as icon + label in bold font
      u8g2.setFont(u8g_font_7x14B);    
      u8g2.drawStr(25, 15+20+2, menu_items[item_selected]);   
      u8g2.drawXBMP( 4, 24, 16, 16, bitmap_icons[item_selected]);     
      // draw next item as icon + label
      u8g2.setFont(u8g_font_7x14);     
      u8g2.drawStr(25, 15+20+20+2+2, menu_items[item_sel_next]);   
      u8g2.drawXBMP( 4, 46, 16, 16, bitmap_icons[item_sel_next]);  
      // draw scrollbar background
      u8g2.drawXBMP(128-8, 0, 8, 64, bitmap_scrollbar_background);
      // draw scrollbar handle
      u8g2.drawBox(125, 64/NUM_ITEMS * item_selected, 3, 64/NUM_ITEMS); 
      u8g2.sendBuffer(); 
    } 
    else if (current_screen == 1 && item_selected == 2) { // wifi
      int resetbutton = analogRead(reset);
    // check if wifi is interupted
      if (wasConnected && !isConnected) {
        Serial.println("Internet connection was interrupted.");
        checkAndReconnectWiFi();
      }
      if (!clearDisplayQR){
            u8g2.sendBuffer(); 
            clearDisplayQR = true;
        }
      else if (currentStationCount >= 1 && WiFi.status() != WL_CONNECTED) {
            Serial.println("user connected");
            u8g2.drawXBMP( 0, 0, 128, 64, epd_bitmap_SCAN_TO_GO_WEBSITE);
      } 
      else if (currentStationCount < 1 && WiFi.status() != WL_CONNECTED){
            Serial.println("user has not connected to the ESP32 WiFi.");
            u8g2.drawXBMP(0, 0, 128, 64, epd_bitmap_scan_to_connect);
      }   
      if (resetbutton == 4095 && WiFi.status() == WL_CONNECTED){
        Serial.print("network dissconnected");
        Serial.print(" button value: ");
        Serial.println(resetbutton);
        preferences.begin("credentials", false);
        preferences.clear();
        preferences.end();
        WiFi.disconnect();
        // pressed = true;
      }else if (WiFi.status() == WL_CONNECTED && Firebase.ready() && signupOK && (millis() - sendDataPrevMillis > 1000 || sendDataPrevMillis == 0 )){
        
        Serial.println(resetbutton);
            struct tm timeinfo;
            u8g2.clearBuffer();
            u8g2.drawXBMP(0, 0, 20, 16, epd_bitmap_wifi);
            setTime();   
            u8g2.setCursor(5,55);
            //make a gm gn and afternoon 
            u8g2.print("Goodevening ");
            u8g2.print(firstName().c_str()); 
            u8g2.sendBuffer(); 

            sendDataPrevMillis = millis();
            int value0 = channel0();
            pressed = false;
            if (Firebase.RTDB.setInt(&fbdo, "sensor/slot-1", value0)){
              Serial.println();
              Serial.print(value0);
              Serial.print(" success: " );
              Serial.print(fbdo.dataPath());
              Serial.print(" TYPE: " );
              Serial.println(fbdo.dataType());
            }else {
              Serial.print("FAILED");
              Serial.print("REASON: " );
              Serial.println(fbdo.errorReason());
            }
          }
      wasConnected = isConnected;
}   

    else if (current_screen == 1 && item_selected == 0){ //offline 
                                    //  for offline function

                  if (digitalRead (BUTTON_SELECT_PIN) == 0 ) {
                    condition_set = 1;
                    set = set +1;
                    if (set > 3) {
                      set = 0;
                    }
                    delay(100);
                  }
                  } else {
                    condition_set = 0;
                  }

                  if (digitalRead(BUTTON_UP_PIN) == 0 ) {
                    if (set == 0) {
                      tdown.start();
                    }
                  if (set == 1) {
                    seconds++;
                    last_seconds == seconds;
                  }
                  if (set == 2) {
                    seconds++;
                    last_minutes == minutes;
                  }
                  if (set == 3) {
                    seconds++;
                    last_hours == hours;
                  }
                  if (seconds > 59) {
                    seconds = 0;
                  }
                  if (minutes > 59) {
                    minutes = 0;
                  }
                  if (hours > 59) {
                    hours = 0;
                  }
                  delay(200);
                  }
                  if (digitalRead (BUTTON_DOWN_PIN) == 0 ) {
                    lastmillis = millis();
                    condition_reset = 0;
                    while (digitalRead (BUTTON_DOWN_PIN) == 0 && set == 0) {
                      if (millis() - lastmillis > 500) {
                        condition_reset = 1;
                        tdown.stop();
                        seconds = last_seconds;
                        minutes = last_minutes;
                        hours = last_hours;

                        u8g2.setCursor(5,55);
                        if(hours <=9) {
                          u8g2.print("0");
                        }
                        u8g2.print(hours);
                        u8g2.print(":");
                        if (minutes <= 9) {
                          u8g2.print("0");
                        }
                        u8g2.print(minutes);
                        u8g2.print(":");
                        if (seconds <= 9) {
                          u8g2.print("0");
                        }
                        u8g2.print(seconds);
                        u8g2.print("   ");
                        delay(100);
                      }
                    }

                    if (condition_reset == 0) {
                      if (set == 0) {
                        tdown.stop();
                      }
                      if (set == 1) {
                        seconds--;
                        last_seconds = seconds;
                    }
                    if (set == 2) {
                        minutes--;
                        last_minutes = minutes;
                    }
                    if (set == 3) {
                        hours--;
                        last_hours = hours;
                    }
                    if (seconds > 59) {
                    seconds = 0;
                  }
                  if (minutes > 59) {
                    minutes = 0;
                  }
                  if (hours > 59) {
                    hours = 0;
                  }
                  delay(200);

                  }
                      u8g2.setCursor(5,55);
                        if(set==0){u8g2.print("      Timer     ");}
                        if(set==1){u8g2.print("  Set Timer SS  ");}
                        if(set==2){u8g2.print("  Set Timer MM  ");}
                        if(set==3){u8g2.print("  Set Timer HH  ");}
                    
                        //screen display timer
                    u8g2.setCursor(5,55);
                    if(hours<=9){u8g2.print("0");}
                    u8g2.print(hours);
                    u8g2.print(":");
                    if(minutes<=9){u8g2.print("0");}
                    u8g2.print(minutes);
                    u8g2.print(":");
                    if(seconds<=9){u8g2.print("0");}
                    u8g2.print(seconds);
                    u8g2.print("   ");
                  tdown.stop(); 
                  digitalWrite(buzzer, HIGH);
                  delay(300);
                  digitalWrite(buzzer, LOW);
                  delay(200);
                  digitalWrite(buzzer, HIGH);
                  delay(300);
                  digitalWrite(buzzer, LOW);
                  delay(200);
                  digitalWrite(buzzer, HIGH);
                  delay(300);
                  digitalWrite(buzzer, LOW);
                  
}
    else if (current_screen == 1 && item_selected == 1){ //info 
      u8g2.setFont(u8g_font_6x10);   
      for (int i = 0; i < 6; ++i) {
        if (i < 6) {
            u8g2.drawStr(3, 12 + 10 * i, messages[i]);  
        }
      }
}
    else if (current_screen == 2 && item_selected == 1){ //info 
      u8g2.setFont(u8g_font_6x10);   
      for (int i = 0; i < 6; ++i) {
        if (i < 6) {
            u8g2.drawStr(3, 12 + 10 * i, info[i]);  // Adjust vertical spacing accordingly
        }
      }
      // Send buffer to the display
      u8g2.sendBuffer();
}
  u8g2.sendBuffer(); // send buffer from RAM to display controller
}
